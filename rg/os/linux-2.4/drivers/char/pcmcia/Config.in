## rg/os/linux-2.4/net/ipv6/Config.in
```kconfig
#
# IPv6 configuration
#

#mainmenu_option next_comment
#comment '  IPv6 Configuration'

# --- overall ---
bool '    IPv6: Verbose debugging messages' CONFIG_IPV6_DEBUG

# --- module interface ---
if [ "$CONFIG_IPV6" = "m" ]; then
   bool '    IPv6: inter-module support.' CONFIG_IPV6_IM
   if [ "$CONFIG_NET_IPGRE" != "n" ]; then
      bool '      IPv6: enable gre tunnel support with modulized ipv6' CONFIG_IPV6_MODULE_IP_GRE
   fi
fi

# --- IPv6 Specification (RFC2460) and Addressing Architecture (RFC2373) ---
#bool '    IPv6: Loose scope_id' CONFIG_IPV6_LOOSE_SCOPE_ID
bool '    IPv6: drop packets with fake ipv4-mapped address(es)' CONFIG_IPV6_DROP_FAKE_V4MAPPED
if [ "$CONFIG_IPV6" = "y" -o "$CONFIG_IPV6_IM" = "y" ]; then
   bool '    IPv6: Restrict "double binding" only for same user' CONFIG_IPV6_RESTRICTED_DOUBLE_BIND
fi
bool '    IPv6: 6to4-address in nexthop support.' CONFIG_IPV6_6TO4_NEXTHOP
bool '    IPv6: Privacy Extensions (RFC 3041) support' CONFIG_IPV6_PRIVACY
bool '    IPv6: anycast support' CONFIG_IPV6_ANYCAST
if [ "$CONFIG_IPV6_ANYCAST" != "n" ]; then
	define_bool CONFIG_IPV6_ANYCAST_GROUP y
fi

# --- ISATAP interface ---
if [ "$CONFIG_EXPERIMENTAL" = "y" ]; then
    bool '    IPv6: ISATAP interface support (EXPERIMENTAL)' CONFIG_IPV6_ISATAP
fi

# --- NDP (RFC2461) ---
if [ "$CONFIG_IPV6_DEBUG" = "y" ]; then
   bool '    IPv6: Neighbor Discovery debugging' CONFIG_IPV6_NDISC_DEBUG
fi

# --- Stateless Address Configuration (RFC2462) ---
if [ "$CONFIG_IPV6_DEBUG" = "y" ]; then
   bool '    IPv6: Address Autoconfigration debugging' CONFIG_IPV6_ACONF_DEBUG
   if [ "$CONFIG_IPV6_ACONF_DEBUG" = "y" ]; then
      bool '      IPv6: Debug on source address selection' CONFIG_IPV6_ACONF_DEBUG_SADDR
   fi
fi

# --- Routing ---
if [ "$CONFIG_IPV6_DEBUG" = "y" ]; then
   bool '    IPv6: Routing Information debugging' CONFIG_IPV6_RT6_DEBUG
fi
bool '    IPv6: sub-tree in routing table support (just for testing)' CONFIG_IPV6_SUBTREES

# --- MLD (RFC2710) ---
if [ "$CONFIG_IPV6_DEBUG" = "y" ]; then
   bool '    IPv6: Multicast Listener Discovery debugging' CONFIG_IPV6_MLD6_DEBUG
fi
bool '    IPv6: disable optimization MLD6 Done message' CONFIG_IPV6_MLD6_ALL_DONE

# --- Node Information Queries (Internet Draft) ---
bool '    IPv6: enable Node Information Queries' CONFIG_IPV6_NODEINFO
if [ "$CONFIG_IPV6_NODEINFO" = "y" ]; then
   if [ "$CONFIG_IPV6_DEBUG" = "y" ]; then
       bool '      IPv6: Node Information Queries debugging' CONFIG_IPV6_NODEINFO_DEBUG
   fi
   bool '      IPv6: regard NIS domain as DNS domain' CONFIG_IPV6_NODEINFO_USE_UTS_DOMAIN
fi

# --- Socket Interface (RFC2292, RFC2553) ---

# --- Filtering ---
if [ "$CONFIG_NETFILTER" != "n" ]; then
   source net/ipv6/netfilter/Config.in
fi

# --- Misc. ---
#bool '    IPv6: flow policy support' CONFIG_RT6_POLICY
#bool '    IPv6: firewall support' CONFIG_IPV6_FIREWALL

# -- IPsec --
if [ "$CONFIG_EXPERIMENTAL" = "y" ]; then
   if [ "$CONFIG_IPSEC" != "n" ] ; then
      bool '    IPv6: IP Security Support (EXPERIMENTAL)' CONFIG_IPV6_IPSEC 
   fi
   if [ "$CONFIG_IPSEC_TUNNEL" != "n" ]; then
      define_bool CONFIG_IPV6_IPSEC_TUNNEL y
   fi
fi

# --- Mobile IP ---
dep_tristate '    IPv6: IPv6 over IPv6 Tunneling (EXPERIMENTAL)' CONFIG_IPV6_IPV6_TUNNEL m

#endmenu
```

## rg/pkg/freeswan/klips/net/ipsec/defconfig
```kconfig
#
# FreeS/WAN IPSec implementation, KLIPS kernel config defaults
#

#
# First, lets override stuff already set or not in the kernel config.
#
# We can't even think about leaving this off...
CONFIG_INET=y

#
# This must be on for subnet protection.
CONFIG_IP_FORWARD=y

# Shut off IPSEC masquerading if it has been enabled, since it will 
# break the compile.  IPPROTO_ESP and IPPROTO_AH were included in 
# net/ipv4/ip_masq.c when they should have gone into include/linux/in.h.
CONFIG_IP_MASQUERADE_IPSEC=n

# modular algo extensions (and new ALGOs)
CONFIG_IPSEC_ALG=y
CONFIG_IPSEC_ALG_AES=m
CONFIG_IPSEC_ALG_TWOFISH=m
CONFIG_IPSEC_ALG_SERPENT=m


# Use CryptoAPI for ALG?
CONFIG_IPSEC_ALG_CRYPTOAPI=n

#
# Next, lets set the recommended FreeS/WAN configuration.
#

# To config as static (preferred), 'y'.  To config as module, 'm'.
CONFIG_IPSEC=m

# To do tunnel mode IPSec, this must be enabled.
CONFIG_IPSEC_IPIP=y

# To enable authentication, say 'y'.   (Highly recommended)
CONFIG_IPSEC_AH=y

# Authentication algorithm(s):
CONFIG_IPSEC_AUTH_HMAC_MD5=y
CONFIG_IPSEC_AUTH_HMAC_SHA1=y

# To enable encryption, say 'y'.   (Highly recommended)
CONFIG_IPSEC_ESP=y

# Encryption algorithm(s):
CONFIG_IPSEC_ENC_3DES=y

# IP Compression: new, probably still has minor bugs. (changed to 'n' for PCBOX)
CONFIG_IPSEC_IPCOMP=n

# To enable userspace-switchable KLIPS debugging, say 'y'.
CONFIG_IPSEC_DEBUG=y
```

## rg/vendor/cavium/octeon/linux-2.6/kernel/Kconfig.octeon
```kconfig
config CAVIUM_OCTEON_SPECIFIC_OPTIONS
	bool "Enable Octeon specific options"
	depends on CPU_CAVIUM_OCTEON
	default "y"

config CAVIUM_OCTEON_BOOTBUS_COMPACT_FLASH
	bool "Enable support for Compact flash hooked to the Octeon Boot Bus"
	depends on CAVIUM_OCTEON_SPECIFIC_OPTIONS
	default "y"
	help
	  This option enables a polled compact flash driver for use with
	  compact flash cards attached to the Octeon boot bus. This interface
	  is quite slow. It has a maximum rate of about 1.5 MB/s.

config CAVIUM_OCTEON_HW_FIX_UNALIGNED
	bool "Enable hardware fixups of unaligned loads and stores"
	depends on CAVIUM_OCTEON_SPECIFIC_OPTIONS
	default "y"
	help
	  Configure the Octeon hardware to automatically fix unaligned loads
	  and stores. Normally unaligned accesses are fixed using a kernel
	  exception handler. This option enables the hardware automatic fixups,
	  which requires only an extra 3 cycles. Disable this option if you
	  are running code that relies on address exceptions on unaligned
	  accesses.

config CAVIUM_OCTEON_CVMSEG_SIZE
	int "Number of L1 cache lines reserved for CVMSEG memory"
	depends on CAVIUM_OCTEON_SPECIFIC_OPTIONS
	range 0 54
	default 0
	help
          CVMSEG LM is a segment that accesses portions of the dcache as a
	  local memory; the larger CVMSEG is, the smaller the cache is.
	  This selects the size of CVMSEG LM, which is in cache blocks. The
	  legally range is from zero to 54 cache blocks (i.e. CVMSEG LM is
	  between zero and 6192 bytes).

config CAVIUM_OCTEON_USER_IO
	bool "Allow User space to access hardware IO directly"
	depends on CAVIUM_OCTEON_SPECIFIC_OPTIONS
	help
	  Allows user applications to directly access the Octeon hardware
	  IO addresses (0x1000000000000 - 0x1ffffffffffff). This allows high
	  performance networking applications to run in user space with minimal
	  performance penalties. This also means a user application can bring
	  down the entire system. Only use this option on embedded devices
	  where all user applications are strictly controlled.

config CAVIUM_OCTEON_USER_MEM
	bool "Allow User space to access memory directly"
	depends on CAVIUM_OCTEON_SPECIFIC_OPTIONS
	depends on CAVIUM_OCTEON_USER_IO
	help
	  Allows user applications to use XKPHYS addresses directly to memory.
	  This allows user space direct access to shared memory not in use by
	  Linux. This memory is suitable for use with the Octeon hardware.
	  Cavium simple executive applications also share this memory. Since
	  this bypass all of the Linux memory protection, only use this option
	  on embedded devices where all user applications are strictly
	  controlled.

config CAVIUM_RESERVE32
	int "Memory to reserve for user processes shared region (MB)"
	range 0 1024
	depends on CAVIUM_OCTEON_SPECIFIC_OPTIONS
	depends on CAVIUM_OCTEON_USER_IO
	default "0"
	help
	  Reserve a shared memory region for user processes to use for hardware
	  memory buffers. This is required for 32bit applications to be able to
	  send and receive packets directly. Applications access this memory by
	  memory mapping /dev/mem for the addresses in /proc/octeon_info. For
	  optimal performance with HugeTLBs, keep this size an even number of
	  megabytes.

config CAVIUM_OCTEON_NUM_PACKET_BUFFERS
	int "Number of packet buffers (and work queue entries) for shared access"
	range 0 8192
	depends on CAVIUM_OCTEON_SPECIFIC_OPTIONS
	depends on CAVIUM_OCTEON_USER_IO
	default "0"
	help
	  Number of packet buffers (and work queue entries) to allocate from
	  reserved user memory. These buffers are in the userspace address
	  range and may be used for zero copy access to ethernet packets from
	  userspace. Normal kernel ethernet performance will suffer since
	  received ethernet packets will need to be copied from these buffers
	  into the normal kernel skbuf structures. Only use this option if
	  high performance ethernet is need in userspace, bypassing the kernel.
	  This will reduce the userspace shared region by
	  (2048 + 128) * (number of buffers).

config ARCH_SPARSEMEM_ENABLE
	def_bool y
	depends on CPU_CAVIUM_OCTEON
    
config CAVIUM_OCTEON_IPSEC
   bool "Enable enhancements to the IPSec stack to allow procotol offload."
   depends on CAVIUM_OCTEON_SPECIFIC_OPTIONS
   default "n"
   help
     This enables enhancements to the IPSec stack to allow some of the
     processing required for IPSec to be performed on another processor
     which must be running the ipsec-filter application.
```

## rg/vendor/marvell/feroceon/linux-2.6/arch/arm/mach-feroceon-kw2/Kconfig
```kconfig
if ARCH_FEROCEON_KW2

choice
	prompt "Feroceon-KW2 SoC type"
	default MV88F6500

config  MV88F6500
	bool "88F6510/88F6530/88F6550/88F6560/ SoC"
	select MV_KERN_VER_2_6_22

	---help---
	Choosing this option will generate a linux kernel for the 88F6510/88F6530/88F6550/88F6560/ SoC

endchoice

config MV_KERN_VER_2_6_22
	bool

endif
```
