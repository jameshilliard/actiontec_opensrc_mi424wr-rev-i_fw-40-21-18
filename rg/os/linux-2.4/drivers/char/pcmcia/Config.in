## rg/vendor/marvell/feroceon/linux-2.6/arch/arm/plat-feroceon/Kconfig
```kconfig
if ARCH_FEROCEON

menu "Feroceon SoC options"
	depends on ARCH_FEROCEON

#since the Kconfig parser dispatch all source commands, we call the machines Kconfigs from here and
#not vice versa because otherwise the plat-feroceon Kconfig will be dispatched twice.     
if ARCH_FEROCEON_KW2
source "arch/arm/mach-feroceon-kw2/Kconfig"
endif

config JTAG_DEBUG
        bool "Enable JTAG by disable \"wait for interrupt\"."
	depends on MV88F6500 || MV88F6281 || MV78XX0
        default n
        ---help---
           Enable the JTAG debugger taking over the CPU by disabling "wait for interrupt" idle loop."


menu "Feroceon SoC Included Features"

config MV_INCLUDE_PEX
	bool "PCI Express Support"
	depends on PCI && MV88F6500 || MV88F6281 || MV78XX0
	default y
        ---help---
        Please don't change this configs unless you know what you are doing.

config MV_INCLUDE_USB
	bool "USB Support"
	depends on MV88F6500 || MV88F6281 || MV78XX0
	default y
        ---help---
        Please don't change this configs unless you know what you are doing.

config MV_INCLUDE_XOR
	bool "XOR Support"
	depends on MV88F6500 || MV88F6281 || MV78XX0 
	default y
        ---help---
        Please don't change this configs unless you know what you are doing.

config MV_INCLUDE_CESA
	bool "CESA Support"
	depends on MV88F6500 || MV88F6082 || MV88F6183 || MV88F6281 || MV78XX0
	default y
        ---help---
        Please don't change this configs unless you know what you are doing.

config MV_INCLUDE_NAND
	bool "NAND Support"
	depends on MV88F6500 || MV88F6281 || MV78XX0
	default y
        ---help---
        Please don't change this configs unless you know what you are doing.

config MV_INCLUDE_INTEG_SATA
	bool "Integrated SATA Support"
	depends on MV88F6500 || MV88F6281 || MV78XX0
	default y
        ---help---
        Please don't change this configs unless you know what you are doing.

config MV_INCLUDE_TDM
	bool "Integrated TDM Support"
	depends on MV88F6500 || MV88F6281 || MV78XX0 
	default y
        ---help---
        Please don't change this configs unless you know what you are doing.

config MV_INCLUDE_GIG_ETH
	bool "Giga Ethernet Support"
	depends on MV88F6500 || MV88F6281 || MV78XX0
	default y

config MV_INCLUDE_SPI
	bool "SPI Support"
	depends on MV88F6500 || MV88F6281 || (MV78XX0 && !MV78XX0_Z0)
	default y
        ---help---
        Please don't change this configs unless you know what you are doing.

config MV_INCLUDE_SDIO
	bool "SDIO Support"
	depends on MV88F6500 || MV88F6281
	default y
        ---help---
        Please don't change this configs unless you know what you are doing.

config MV_INCLUDE_TS
	bool "TSU Support"
	depends on MV88F6500 || MV88F6281
	default n
        ---help---
        Please don't change this configs unless you know what you are doing.

config MV_INCLUDE_PON
	bool "PON Support"
	depends on MV88F6500
	default y
        ---help---
        Please don't change this configs unless you know what you are doing.

config MV_INCLUDE_SWITCH
        bool "Ethernet Switch Support"
        depends on MV88F6500 || MV88F6281 || MV78XX0
        default y

endmenu

config MV_GPP_MAX_PINS
	int
	default 32 if MV78XX0
	default 64 if MV88F6281
	default 70 if MV88F6500

	
config MV_DCACHE_SIZE
	hex
	default 0x8000 if MV78XX0
	default 0x4000 if MV88F6500 || MV88F6281

config MV_ICACHE_SIZE
	hex
	default 0x8000 if MV78XX0
	default 0x4000 if MV88F6500 || MV88F6281
	          
menu "Feroceon SoC MTD support"

config MV_FLASH_CTRL
	bool
	default n

choice
	prompt "Marvell Flash Support"
	depends on MTD
	default MV_NAND

config MV_INCLUDE_NORFLASH_MTD
    bool "Marvell support for MTD NOR flash device"
    select MV_FLASH_CTRL
    depends on MTD_CFI

config MV_INCLUDE_SFLASH_MTD
    bool "Marvell support for MTD SPI flash device"
    select MV_FLASH_CTRL
    depends on MV_INCLUDE_SPI

config MV_SPI_BOOT
	bool "Marvell boot support from MTD SPI device"
	depends on MV_INCLUDE_SFLASH_MTD
	---help---
	Choose this option if SPI MTD is the system boot device.
	This option controls the various flash types support in the board
	device chip-select information structure under mvBoardEnvSpec.c
                    
config MV_INCLUDE_MFLASH_MTD
    bool "Marvell support for MTD Marvell flash device"
    select MV_FLASH_CTRL
    depends on MV_INCLUDE_INTEG_MFLASH

config MV_NAND
	bool "Marvell support for MTD NAND device"
	depends on MV_INCLUDE_NAND

config MV_NAND_BOOT
	bool "Marvell boot support from MTD NAND device"
	depends on MV_NAND
	default y
	---help---
	Choose this option if NAND MTD is the system boot device.	            
	This option controls the various flash types support in the board
	device chip-select information structure under mvBoardEnvSpec.c

config NAND_RS_ECC_SUPPORT
	bool "Support Reed-Solomon 4-bit ECC algorithm"
	depends on MV_NAND
	default y
	---help---
	Choose this option to support Reed-Solomon 4-bit ECC algorithm.
	Note this option also requires support by low-level boot loader.

config MV_NAND_8BYTE_READ
	bool "Support NAND 8 Byte Read burst algorithm"
	depends on MV_NAND
	---help---
	Choose this option to support NAND 8 Byte Read burst algorithm.

endchoice

endmenu

choice
	prompt "SoC USB Mode"
	depends on MV_INCLUDE_USB && !UBOOT_STRUCT
	default MV_USB_HOST

config MV_USB_HOST
	bool "Support for USB Host"
	---help---
	Choosing this option will configure on chip USB Controller to work in Host mode

config MV_USB_DEVICE
	bool "Support for USB Device"
	---help---
	Choosing this option will configure on chip USB Controller to work in Device mode
endchoice


config ARCH_SUPPORTS_BIG_ENDIAN
	bool
	default y

config USE_DSP
	bool "Use pld/ldrd/strd arm DSP instructions"
	default n

config L2_CACHE_ENABLE
	bool "Enable L2 cache support"
	depends on ARCH_FEROCEON_KW2 || ARCH_FEROCEON_KW || ARCH_FEROCEON_MV78XX0
	default n
        
config CPU_L2_DCACHE_WRITETHROUGH
	depends on L2_CACHE_ENABLE
	bool "Force L2 write through D-cache"
	default y
	---help---
	Choosing this option will configure L2 to write-through operation mode, 
	otherwise L2 mode will be set to write-back.

choice
	prompt "Protect from speculative instruction prefetch"
	depends on L2_CACHE_ENABLE
	default MV_SP_I_FTCH_DB_INV

config MV_SP_I_FTCH_DB_INV
	bool "Double invalidate for DMA buffers"
	---help---
	Choosing this option will add L2 invalidate for DMA recieved buffers before processing it,
	This is done through the pci_unmap_sg/page/single APIs.

config MV_SP_I_FTCH_LCK_L2_ICACHE
	bool "Lock L2 I-cache"
	---help---
	Choosing this option will lock L2 Icache.

config MV_SP_I_FTCH_NONE
	bool "Ignore"

endchoice

config MV_INTERNAL_REGS_SELECTIVE_MAPPING
	bool "Internal registers selective mapping"
	default n
	---help---
	Choosing this option enables selective address mapping for each unit,
        in the internal registers address space.


config  FEROCEON_PROC
	bool "Support for MV-shell proc file system"
	depends on PROC_FS
	---help---	
	  Choosing this option will enable you to use the MV-shell through the Proc
	  File system.
	  The MV-shell is a debug utility which can be run from the shell.

config	MV_PMU_PROC
	bool "Support procfs control on Power-Management features"
	depends on PROC_FS
	---help---	
	  Choose this option to enable control over the power-management features through
	  the proc file-system.

config  UBOOT_STRUCT
	bool "Use UBoot Marvell tag structure"
	---help---
	  Choosing this option will cause the linux to extract the Tclk, Sysclk and
	  the uboot version from the Tag list passed by the uboot.

config  MV_DBG_TRACE
	bool "Enable tracing utility"
	default n
	---help---
	  Choosing this debug option will cause some kernel modules to log operations into
	  a cyclic buffer and dump them on failures. Enabling this feature decreases performance.

config  MV_REAL_TIME
	bool "Real Time softirq support"
	default n
	---help---
	Choosing this option will give more CPU time for user space processes

config  MV_CPU_PERF_CNTRS
        bool "CPU Performance counters support"
        default n
        ---help---
        Choosing this option will enable you to use CPU Performance counters

config  MV_CPU_L2_PERF_CNTRS
        bool "CPU L2 Performance counters support"
        default n
        ---help---
        Choosing this option will enable you to use CPU L2 Performance counters

menu "Soc DMA accelerations"

source arch/arm/plat-feroceon/mv_drivers_lsp/mv_xor/Kconfig

source arch/arm/plat-feroceon/mv_drivers_lsp/mv_dma/Kconfig

endmenu


menu "SoC Networking support"
depends on MV_INCLUDE_GIG_ETH

config MV_ETHERNET
        bool "Networking support"
	depends on MV_INCLUDE_GIG_ETH
	default y
        ---help---
        Choose this option to support Marvell Gigabit Ethernet Controller 

if MV_ETHERNET

choice 
        prompt "GbE Mode"
        depends on MV_INCLUDE_GIG_ETH 
        default MV_ETH_LEGACY

config MV_ETH_LEGACY
        bool "Legacy mode "
        ---help---

config MV_ETH_NETA
        bool "Acceleration mode "
	depends on ARCH_FEROCEON_KW2
        ---help---

endchoice


if MV_ETH_LEGACY
source arch/arm/plat-feroceon/mv_drivers_lsp/mv_network/Kconfig
endif

if MV_ETH_NETA
source arch/arm/plat-feroceon/mv_drivers_lsp/mv_neta/Kconfig
endif

endif # MV_ETHERNET
endmenu # "SoC Networking support"

source arch/arm/plat-feroceon/mv_drivers_lsp/mv_cesa/Kconfig

#source arch/arm/plat-feroceon/mv_drivers_lsp/mv_phone/Kconfig


#source arch/arm/plat-feroceon/mv_drivers_lsp/mv_sdio/Kconfig

source arch/arm/plat-feroceon/mv_drivers_lsp/mv_tsu/Kconfig

#source arch/arm/plat-feroceon/mv_drivers_lsp/mv_pon/Kconfig


config  SCSI_MVSATA
	tristate "Support for Marvell Sata Adapters"
	depends on ( MV_INCLUDE_INTEG_SATA && SCSI ) || ( PCI && SCSI )
	---help---
	  Choosing this option will enable you to use the Marvell Sata
	  adapters support with emulation as SCSI adapters.
	  Note that the kernel scsi subsystem must be chosen too.

source arch/arm/plat-feroceon/mv_drivers_lsp/mv_sata/Kconfig

config PCIE_VIRTUAL_BRIDGE_SUPPORT
        bool "Enable virtual bridge on PCIe"
        depends on PCI
        ---help---
        Enable virtual bridge module to support PCIe switches

config MV_UART_POLLING_MODE
        bool "Enable Polling mode for UART driver"
        depends on ARCH_FEROCEON_KW2
	default y
        ---help---
        Configure UART driver to work in polling mode.

config MV_PRINTK_SLICE_SUPPORT
        bool "Support printk buffer slicing"
        depends on ARCH_FEROCEON_KW2 && PRINTK
	default n
        ---help---
        Enable printk buffer chunks slicing to reduce interrupts locking periods.

config MV_PRINTK_CHUNK_SIZE
        int "Support printk buffer slicing"
        depends on MV_PRINTK_SLICE_SUPPORT
	default 16
        ---help---
        Select printk buffer chunk granularity.


endmenu


endif
```

## rg/vendor/marvell/feroceon/linux-2.6/arch/arm/plat-feroceon/mv_drivers_lsp/mv_cesa/Kconfig
```kconfig
menu "Cesa options"
	depends on MV_INCLUDE_CESA

config  MV_CESA
	bool "Support for Marvell Cryptographic Engine and Security Acceleration"
	default y

config  MV_CESA_TOOL
	tristate "Support for Marvell CESA Tool"
	depends on MV_CESA
	---help---

config MV_CESA_CHANNELS
	int "Total CESA HW channels supported"
        depends on MV_CESA
	range 1 2
        default 1
         ---help---
	Select the number of CESA channels to be used for crypto operations acceleration.

config MV_CESA_CHAIN_MODE
	bool "Support CESA chain-mode"
        depends on MV_CESA
        default n
         ---help---
        Choosing this option will enable crypto engine(CESA) chain mode support.
	Warning: currently this feature is supported only by NFP-IPSec.

choice 
        prompt "CESA Mode"
        depends on MV_CESA
        default MV_CESA_OCF

config	MV_CESA_OCF
	bool "Support for Marvell CESA OCF driver"
	depends on OCF_OCF
	---help---
	  Choosing this option will enable you to use the Marvell Cryptographic Engine and
	  Security Accelerator, under the OCF package.

config  MV_CESA_TEST
	bool "Support for Marvell CESA test driver"
	depends on MV_CESA_TOOL 
	---help---
	  Choosing this option will enable you to use the Marvell Cryptographic Engine and
	  Security Accelerator, with the mv_cesa_tool in test mode.
endchoice

endmenu
```
